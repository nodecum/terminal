## app/boards/shields/ssd1306/Kconfig.defconfig
```kconfig
if SHIELD_SSD1306_ADAFRUIT_FEATHER_OLED_128X32 

if DISPLAY

choice SSD1306_CONTROLLER_TYPE
endchoice

endif # DISPLAY

endif # SHIELD_SSD1306_ADAFRUIT_FEATHER_OLED_128X32 
```

## app/boards/shields/ssd1306/Kconfig.shield
```kconfig
# Copyright (c) 2019 Linaro Limited
# SPDX-License-Identifier: Apache-2.0

config SHIELD_SSD1306_ADAFRUIT_FEATHER_OLED_128X32
	def_bool $(shields_list_contains,ssd1306_adafruit_feather_oled_128x32)
```
